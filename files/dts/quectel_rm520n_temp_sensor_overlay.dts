/dts-v1/;
/plugin/;

/ {
    fragment@0 {
        target-path = "/";
        __overlay__ {
            quectel_rm520n_temp: quectel_rm520n@0 {
                compatible = "quectel-rm520n-temp-sensor";
                // Kein "reg", etc. – der Sensor ist rein virtuell
            };
        };
    };
};